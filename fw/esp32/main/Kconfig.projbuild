## fw/esp32/main/Kconfig.projbuild
```kconfig
menu "WULPUS Pro Max Configuration"

    menu "Power Management"

    config WP_ENABLE_PM
        bool "Enable power management"
        default y
        help
            This enables power management.
    
    config WP_PM_MIN_FREQUENCY
        int "Minimum frequency for DFS"
        default 10
        range 1 100
        help
            This sets the minimum frequency for DFS in MHz.
            The default value is 10 MHz.
        depends on WP_ENABLE_PM

    endmenu

    menu "Double Reset"

    config WP_DOUBLE_RESET
        bool "Double reset detection"
        default y
        help
            This erases the NVS to reset provisioned status of the device on double reset.

    config WP_DOUBLE_RESET_TIMEOUT
        int "Double reset timeout [ms]"
        default 2000
        range 1000 20000
        help
            This sets the timeout for double reset detection in milliseconds.
            The default value is 2000 milliseconds.
        depends on WP_DOUBLE_RESET

    endmenu

    menu "Networking"

    config WP_SOCKET_PORT
        int "Socket port"
        default 2121
        range 1 65535
        help
            This sets the socket port for the server.
            The default value is 2121.

    config WP_SERVER_STACK_SIZE
        int "Server task stack size [bytes]"
        default 4096
        range 1024 16384
        help
            This sets the server task stack size in bytes.
            The default value is 4096 bytes.

    config WP_SERVER_PRIORITY
        int "Server task priority"
        default 5
        range 1 10
        help
            This sets the server task priority.
            The default value is 5.

    config WP_SERVER_RX_BUFFER_SIZE
        int "Server RX buffer size [bytes]"
        default 128
        range 32 8192
        help
            This sets the server RX buffer size in bytes.
            The default value is 128 bytes.

    endmenu

    menu "SPI"

    config WP_SPI_INSTANCE
        int "SPI instance (1 or 2)"
        default 1
        range 1 2
        help
            This sets the SPI instance to use.
            The default value is 1.

    config WP_SPI_MISO
        int "SPI MISO pin"
        default 12
        range 0 39
        help
            This sets the SPI MISO pin.
            The default value is 12.
    
    config WP_SPI_MOSI
        int "SPI MOSI pin"
        default 13
        range 0 39
        help
            This sets the SPI MOSI pin.
            The default value is 13.
    
    config WP_SPI_CLK
        int "SPI CLK pin"
        default 14
        range 0 39
        help
            This sets the SPI CLK pin.
            The default value is 14.

    config WP_SPI_CS
        int "SPI CS pin"
        default 15
        range 0 39
        help
            This sets the SPI CS pin.
            The default value is 15.

    config WP_SPI_MAX_TRANSFER_SIZE
        int "SPI max transfer size [bytes]"
        default 1024
        range 32 8192
        help
            This sets the maximum transfer size for SPI in bytes.
            The default value is 1024 bytes.

    config WP_SPI_CLOCK_SPEED
        int "SPI clock speed [Hz]"
        default 8000000
        range 100000 50000000
        help
            This sets the SPI clock speed in Hz.
            The default value is 8 MHz.

    endmenu

    menu "GPIO"

    config WP_GPIO_DATA_READY
        int "Data ready GPIO pin"
        default 4
        range 0 39
        help
            This sets the data ready GPIO pin.
            The default value is 4.

    config WP_GPIO_MSP_RST_N
        int "MSP430 reset GPIO pin"
        default 0
        range 0 39
        help
            This sets the active-low open-drain MSP430 reset pin.
            The default value is 0 on XIAO ESP32-C6 (D0).

    config WP_GPIO_MSP_TEST
        int "MSP430 TEST GPIO pin"
        default 2
        range 0 39

    config WP_GPIO_MSP_TDO
        int "MSP430 JTAG TDO GPIO pin"
        default 21
        range 0 39

    config WP_GPIO_MSP_TDI
        int "MSP430 JTAG TDI GPIO pin"
        default 22
        range 0 39

    config WP_GPIO_MSP_TMS
        int "MSP430 JTAG TMS GPIO pin"
        default 23
        range 0 39

    config WP_GPIO_MSP_TCK
        int "MSP430 JTAG TCK GPIO pin"
        default 16
        range 0 39

    endmenu

    menu "Data Handling"

    config WP_FRAME_SLOT_COUNT
        int "DMA acquisition frame slots"
        default 64
        range 2 128

    config WP_ACQUISITION_STACK_SIZE
        int "Acquisition thread stack size [bytes]"
        default 3072
        range 2048 16384

    config WP_ACQUISITION_PRIORITY
        int "Acquisition thread priority"
        default 8
        range 1 20

    config WP_PROTOCOL_STACK_SIZE
        int "Protocol thread stack size [bytes]"
        default 4096
        range 2048 16384

    config WP_PROTOCOL_PRIORITY
        int "Protocol thread priority"
        default 6
        range 1 20

    config WP_PACKET_TX_STACK_SIZE
        int "Packet TX thread stack size [bytes]"
        default 3072
        range 2048 16384

    config WP_PACKET_TX_PRIORITY
        int "Packet TX thread priority"
        default 4
        range 1 20

    config WP_LINK_STACK_SIZE
        int "USB/TCP link thread stack size [bytes]"
        default 4096
        range 2048 16384

    config WP_LINK_PRIORITY
        int "USB/TCP link thread priority"
        default 5
        range 1 20

    config WP_PROVISIONING_STACK_SIZE
        int "Provisioning thread stack size [bytes]"
        default 4096
        range 2048 16384

    config WP_PROVISIONING_PRIORITY
        int "Provisioning thread priority"
        default 5
        range 1 20

    config WP_HANDLER_STACK_SIZE
        int "Data handler stack size [bytes]"
        default 2048
        range 1024 16384
        help
            This sets the data handler stack size in bytes.
            The default value is 2048 bytes.

    config WP_HANDLER_PRIORITY
        int "Data handler task priority"
        default 6
        range 1 10
        help
            This sets the data handler task priority.
            The default value is 6.

    config WP_DATA_RX_LENGTH
        int "Data RX length [bytes]"
        default 804
        range 32 8192
        help
            This sets the data RX length in bytes.
            The default value is 804 bytes.

    endmenu

endmenu
```
